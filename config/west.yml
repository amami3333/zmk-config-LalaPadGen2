## config/west.yml
```yaml
manifest:
  remotes:
    - name: zmkfirmware
      url-base: https://github.com/zmkfirmware
    - name: ShiniNet
      url-base: https://github.com/ShiniNet/
    - name: caksoylar
      url-base: https://github.com/caksoylar
    - name: badjeff
      url-base: https://github.com/badjeff
  projects:
    - name: zmk
      remote: zmkfirmware
      revision: v0.3.0
      import: app/west.yml
    - name: zmk-driver-iqs9151
      remote: ShiniNet
      revision: v1.0.0
    - name: zmk-easy-charge-indicator
      remote: ShiniNet
      revision: v1.0.0
    - name: zmk-rgbled-widget
      remote: caksoylar
      revision: v0.3
    - name: zmk-behavior-mouse-key-toggle
      remote: badjeff
      revision: main
  self:
    path: config
```
